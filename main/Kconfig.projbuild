## main/Kconfig.projbuild
```kconfig
menu "Collector simulation"
    config COLLECTOR_WOKWI
        bool "Wokwi-only synthetic BLE and simulated board"
        default n
        depends on IDF_TARGET_ESP32C3
        help
            Simulation only. Replaces BLE radio input and display/button drivers.
            This firmware must not be flashed onto the Passport hardware.
endmenu
```

## sdkconfig.defaults
```kconfig
# --- 目标芯片 ---
CONFIG_IDF_TARGET="esp32c3"
# 注:ESP32-C3 无 PSRAM,故不设 CONFIG_SPIRAM。

# --- Flash ---
# FoloToy AI Passport 当前产品/固件基线使用 8MB Flash。
CONFIG_ESPTOOLPY_FLASHSIZE_8MB=y
# 固定 8MB 镜像头，关闭 detect，便于 idf.py merge-bin。
CONFIG_ESPTOOLPY_HEADER_FLASHSIZE_UPDATE=n
# 默认模板只保留 NVS、PHY data 和占用剩余空间的 factory app；用户可按需修改。
CONFIG_PARTITION_TABLE_CUSTOM=y
CONFIG_PARTITION_TABLE_CUSTOM_FILENAME="partitions.csv"
CONFIG_PARTITION_TABLE_FILENAME="partitions.csv"

# --- 控制台:USB-Serial-JTAG(C3 原生 USB,GPIO18/19)---
# 不用 UART0:其默认 TX=GPIO21 与本板背光引脚冲突。
CONFIG_ESP_CONSOLE_USB_SERIAL_JTAG=y
CONFIG_ESP_CONSOLE_SECONDARY_NONE=y

# --- LVGL ---
CONFIG_LV_COLOR_DEPTH_16=y
# 20 ms display refresh period targets up to 50 FPS when rendering and SPI
# transfer complete within the same budget.
CONFIG_LV_DEF_REFR_PERIOD=20
CONFIG_LV_FONT_MONTSERRAT_14=y
CONFIG_LV_FONT_MONTSERRAT_20=y
# LVGL 内置 malloc 池大小(KB)。它是独立静态区、不与系统堆共享,配大了会白白占用 RAM。
# 本 demo UI 简单,24KB 足够;若自建复杂界面出现绘制卡死/看门狗,调大此值。
CONFIG_LV_MEM_SIZE_KILOBYTES=24

# --- 系统 ---
CONFIG_FREERTOS_HZ=1000

# --- Bluetooth LE / NimBLE ---
# ESP32-C3 仅支持 BLE；采集器只启用被动 Observer。
CONFIG_BT_ENABLED=y
CONFIG_BT_NIMBLE_ENABLED=y
CONFIG_BT_NIMBLE_ROLE_CENTRAL=n
CONFIG_BT_NIMBLE_ROLE_PERIPHERAL=n
CONFIG_BT_NIMBLE_ROLE_BROADCASTER=n
CONFIG_BT_NIMBLE_ROLE_OBSERVER=y
CONFIG_BT_NIMBLE_MAX_CONNECTIONS=1
CONFIG_BT_NIMBLE_HOST_BASED_PRIVACY=n
CONFIG_BT_NIMBLE_NVS_PERSIST=n

# 采集器: 固定只读字体、严格 TLS、无线共存、关闭无线库日志中的用户信息。
CONFIG_LV_FONT_SOURCE_HAN_SANS_SC_16_CJK=n
CONFIG_ESP_COEX_SW_COEXIST_ENABLE=y
CONFIG_ESP_TLS_INSECURE=n
CONFIG_ESP_HTTP_CLIENT_ENABLE_HTTPS=y
CONFIG_LOG_DEFAULT_LEVEL_WARN=y
# Observer 无配对/GATT 角色；关闭安全管理器以匹配 NimBLE 编译单元。
CONFIG_BT_NIMBLE_SECURITY_ENABLE=n

# 控制器同样只保留扫描，关闭连接、广播、配对和射频测试功能。
CONFIG_BT_CTRL_BLE_MASTER=n
CONFIG_BT_CTRL_BLE_ADV=n
CONFIG_BT_CTRL_BLE_SECURITY_ENABLE=n
CONFIG_BT_CTRL_DTM_ENABLE=n
CONFIG_BT_CTRL_BLE_SCAN=y
CONFIG_BT_CTRL_BLE_MAX_ACT=1
# 无连接和 GATT，收紧未使用的 ACL/MSYS 池；广播事件池保留 8 个。
CONFIG_BT_NIMBLE_MSYS_1_BLOCK_COUNT=4
CONFIG_BT_NIMBLE_MSYS_2_BLOCK_COUNT=4
CONFIG_BT_NIMBLE_TRANSPORT_ACL_FROM_LL_COUNT=4
CONFIG_BT_NIMBLE_TRANSPORT_EVT_COUNT=8
CONFIG_BT_NIMBLE_TRANSPORT_EVT_DISCARD_COUNT=8

# 低频 JSON 上报优先保留 RAM；速度和共存表现留待实机验收。
CONFIG_ESP_WIFI_IRAM_OPT=n
CONFIG_ESP_WIFI_RX_IRAM_OPT=n
CONFIG_ESP_WIFI_STATIC_RX_BUFFER_NUM=4
CONFIG_ESP_WIFI_DYNAMIC_RX_BUFFER_NUM=8
CONFIG_ESP_WIFI_DYNAMIC_TX_BUFFER_NUM=8
CONFIG_ESP_WIFI_RX_BA_WIN=4
CONFIG_FREERTOS_PLACE_FUNCTIONS_INTO_FLASH=y
# 保持接收完整 TLS record 的能力，仅按实际使用分配收发缓冲区。
CONFIG_MBEDTLS_DYNAMIC_BUFFER=y
# 与网络模块的两个 SNTP server 保持一致，避免配置数组越界。
CONFIG_LWIP_SNTP_MAX_SERVERS=2
```

## sim/wokwi/sdkconfig.defaults
```kconfig
# 仅供独立 Wokwi 构建使用；不能刷入真实 Passport。
CONFIG_COLLECTOR_WOKWI=y
CONFIG_BT_ENABLED=n
CONFIG_ESP_COEX_SW_COEXIST_ENABLE=n
# 降低云端指令/中断仿真负担；业务毫秒计时不变，实机仍为160MHz/1000Hz。
CONFIG_ESP_DEFAULT_CPU_FREQ_MHZ_80=y
CONFIG_FREERTOS_HZ=100
```
